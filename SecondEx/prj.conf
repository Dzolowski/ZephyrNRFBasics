## CMakeLists.txt
```
cmake_minimum_required(VERSION 3.20.0)
find_package(Zephyr REQUIRED HINTS $ENV{ZEPHYR_BASE})

project(SecondEx)

target_sources(app PRIVATE 
    src/main.c
    src/devices.c
)
```

## Kconfig
```
source "Kconfig.zephyr"

config UART
	bool "Enable my function"
	default n
```

## prj.conf
```kconfig
CONFIG_GPIO=y
# STEP 2 - Enable the serial driver in asynchronous mode
CONFIG_SERIAL=y
CONFIG_UART_ASYNC_API=y
CONFIG_HEAP_MEM_POOL_SIZE=20480
```

## src/main.c
```c
#include "devices.h"
#include <zephyr/kernel.h>
#include <zephyr/device.h>
#include <zephyr/devicetree.h>
#include <zephyr/drivers/gpio.h>
#include <zephyr/sys/printk.h>
#include <zephyr/drivers/uart.h>


static K_FIFO_DEFINE(fifo_uart_rx_data);
int main(void)
{
    int ret;
    printk("working\n");
    if (!checkingdevices(uart))
    {
        return 1;
    }

    if (!checkingdevices(led0.port))
    {
        return 1;
    }

    ret = gpio_pin_configure_dt(&led0, GPIO_OUTPUT_ACTIVE);
    if (ret < 0)
    {
        return 1;
    }

    ret = gpio_pin_configure_dt(&led1, GPIO_OUTPUT_ACTIVE);
    if (ret < 0)
    {
        return 1;
    }

    ret = gpio_pin_configure_dt(&led2, GPIO_OUTPUT_ACTIVE);
    if (ret < 0)
    {
        return 1;
    }

    ret = uart_callback_set(uart, uart_cb, NULL);
    if (ret)
    {
        return 1;
    }

    ret = uart_tx(uart, tx_buf, sizeof(tx_buf), SYS_FOREVER_MS);
    if (ret)
    {
        return 1;
    }

    ret = uart_rx_enable(uart, rx_buf, sizeof rx_buf, RECEIVE_TIMEOUT);
    if (ret)
    {
        return 1;
    }

    while (1)
    {
        k_msleep(SLEEP_TIME_MS);
    }

    return 0;
}
```

## src/devices.c
```c
#include "devices.h"
#include <zephyr/sys/printk.h>
#include <zephyr/devicetree.h>
#include <zephyr/drivers/gpio.h>
#include <zephyr/logging/log.h>
#include <zephyr/kernel.h>
#include <stdlib.h> 


LOG_MODULE_REGISTER(Second_ex,LOG_LEVEL_DBG);
const struct gpio_dt_spec led0 = GPIO_DT_SPEC_GET(DT_ALIAS(led0), gpios);
const struct gpio_dt_spec led1 = GPIO_DT_SPEC_GET(DT_ALIAS(led1), gpios);
const struct gpio_dt_spec led2 = GPIO_DT_SPEC_GET(DT_ALIAS(led2), gpios);
const struct device *uart= DEVICE_DT_GET(DT_NODELABEL(uart0));
struct uart_data_t {
	void *fifo_reserved;
	uint8_t data[128];
	uint16_t len;
};
K_FIFO_DEFINE(uart_fifo);
uint8_t tx_buf[100] =   {"UART EXAMPLE \n\r"
                             "PASSWORD is admin to unlock diodes\n\r"};
uint8_t rx_buf[RECEIVE_BUFF_SIZE] = {0};

void uart_cb(const struct device *dev, struct uart_event *evt, void *user_data)
{
    switch (evt->type)
    {
        case UART_RX_RDY:
          

if ((evt->data.rx.len) > 0)
{
    char *received_line = malloc(evt->data.rx.len );  // +1 na znak null-termination
    printk("Received %d bytes\n", evt->data.rx.len);
// Kopiowanie danych do received_line

// Po przetworzeniu danych

    int line_index = 0;

    static bool mResponsePacketReadyToProcess = false;

    // Copy data into a separate buffer, excluding newline characters
    for (int i = 0; i < evt->data.rx.len; ++i)
    {
        if (evt->data.rx.buf[evt->data.rx.offset + i] != '\r' && evt->data.rx.buf[evt->data.rx.offset + i] != '\n')
        {
            received_line[line_index++] = evt->data.rx.buf[evt->data.rx.offset + i];
        }
        // Check end-of-packet delimiter, assume lf =='/n' for now
        if (evt->data.rx.buf[evt->data.rx.offset + i] == '\n')
        {
            mResponsePacketReadyToProcess = true;
        }
    }

 // Only process the buffer when the entire string has been received
 if (mResponsePacketReadyToProcess)
 {
    mResponsePacketReadyToProcess = false;
    // Null-terminate the string
    received_line[line_index] = '\0';
    printk("Received line: %s\n", received_line);
    // Process the received line as needed
 }
    // Null-terminate the string

    printk("Received line: %s\n", received_line);

    // Process the received line as needed
    // (e.g., check if it equals "admin" and toggle LEDs)
    if (strcmp(received_line, "admin") == 0)
    {
        gpio_pin_toggle_dt(&led0);
        gpio_pin_toggle_dt(&led1);
        gpio_pin_toggle_dt(&led2);
        k_msleep(SLEEP_TIME_MS);
        
    }
    else
    {
        printk("Wrong input\n");
    }
    line_index = 0;
    memset(evt->data.rx.buf, 0, sizeof(evt->data.rx.buf));
    free(received_line);
}

            break;
        case UART_RX_DISABLED:
            uart_rx_enable(dev, rx_buf, sizeof rx_buf, RECEIVE_TIMEOUT);
            break;
        default:
            break;
    }
}

bool checkingdevices(const struct device *dev){
    if (!device_is_ready(dev)){
		LOG_ERR("Device - %s is not readyr\n",dev->name);
		return 0;
	}
	else return 1;	

}
```

## src/devices.h
```c
#ifndef DEVICES_H
#define DEVICES_H
#include <zephyr/drivers/uart.h>

#define SLEEP_TIME_MS   1000
#define RECEIVE_BUFF_SIZE 10
#define RECEIVE_TIMEOUT 100


extern uint8_t tx_buf[100];
extern uint8_t rx_buf[RECEIVE_BUFF_SIZE];
extern const struct device *uart;
extern const struct gpio_dt_spec led0;
extern const struct gpio_dt_spec led1;
extern const struct gpio_dt_spec led2;

void uart_cb(const struct device *dev, struct uart_event *evt, void *user_data);
bool checking_devices(const struct device *dev);
void configure_devices(void);
#endif
```
